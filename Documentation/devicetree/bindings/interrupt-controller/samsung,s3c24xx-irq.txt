## Documentation/devicetree/bindings/interrupt-controller/samsung,s3c24xx-irq.txt
```
Samsung S3C24XX Interrupt Controllers

The S3C24XX SoCs contain custom set of interrupt controllers providing a
varying number of interrupt sources.

The set consists of a main- and a sub-controller as well as a controller
for the external interrupts and on newer SoCs even a second main controller.

The bit-to-interrupt and parent mapping of the controllers is not fixed
over all SoCs and therefore must be defined in the controller description.

Required properties:
- compatible: Compatible property value should be "samsung,s3c24xx-irq".

- reg: Physical base address of the controller and length of memory mapped
  region.

- interrupt-controller : Identifies the node as an interrupt controller
- #interrupt-cells : Specifies the number of cells needed to encode an
  interrupt source. The value shall be 2.

- s3c24xx,irqlist : List of irqtypes found on this controller as
  two-value pairs consisting of irqtype and parent-irq

  parent-irq is always the list position of the irq in the irqlist
  of the parent controller (0..31)

  irqtypes are:
  - 0 .. none
  - 1 .. external interrupts in the main register (GPF0 .. GPF3)
  - 2 .. edge irq in the main register
  - 3 .. for parent-irqs, that have sub-irqs in child controllers
  - 4 .. level irqs in the sub-register
  - 5 .. edge irqs in the sub-register
  - 6 .. external irqs in the external irq register (starting with GPF4)
  - 7 .. irq in the second base irq controller of S3C2416/S3C2450 SoCs

Optional properties:
- interrupt_parent : The parent interrupt controller

Example:

	intc2:interrupt-controller@4a000040 {
		compatible = "samsung,s3c24xx-irq";
		reg = <0x4a000040 0x18>;
		interrupt-controller;
		#interrupt-cells = <2>;

		s3c24xx,irqlist = <7 0 /* 2D */
				   7 0 /* IIC1 */
				   0 0 /* reserved */
				   0 0 /* reserved */
				   7 0 /* PCM0 */
				   7 0 /* PCM1 */
				   7 0 /* I2S0 */
				   7 0>; /* I2S1 */
	};
```

## drivers/net/wireless/mt592x/Kconfig
```kconfig
config MT592X
	tristate "MediaTek MT592X WLAN driver support"
	depends on CFG80211
	select WIRELESS_EXT
	select WEXT_SPY
	select LIB80211
	select FW_LOADER
	---help---
	  A library for Marvell Libertas 8xxx devices.

config MT592X_SPI
	tristate "MT592X SPI cards"
	depends on MT592X && SPI
	---help---
	  A driver for Marvell Libertas 8686 SPI devices.

config MT592X_DEBUG
	bool "Enable full debugging output in the MT592X module."
	depends on MT592X
	---help---
	  Debugging support.
```
