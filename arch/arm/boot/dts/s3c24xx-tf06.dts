/*
 * Qisda ES600 ereader - variant TF06
 *
 * Copyright (c) 2012 Heiko Stuebner <heiko@sntech.de>
 *
 * This program is free software; you can redistribute it and/or modify
 * it under the terms of the GNU General Public License version 2 as
 * published by the Free Software Foundation.
*/

/dts-v1/;
/include/ "skeleton.dtsi"

/ {
	model = "Qisda ES600 ereader - variant TF06 - based on S3C2450";
	compatible = "qisda,tf06", "samsung,s3c2450", "samsung,s3c2416";

//	chosen {
//		bootargs = "root=/dev/ram0 rw ramdisk=8192 console=ttySAC1,115200";
//	};

/*	es600-epd {
		compatible = "qisda,es600-epd";
		driver = "auok1901fb";
		resolution = <0>;
		quirks = <2>;
		fps = <4>;
	};*/
};
